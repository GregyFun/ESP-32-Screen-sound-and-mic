## sdkconfig.defaults
```kconfig
# Target Configuration
CONFIG_IDF_TARGET="esp32s3"

# Flash size configuration (16MB)
CONFIG_ESPTOOLPY_FLASHSIZE_16MB=y
CONFIG_ESPTOOLPY_FLASHSIZE="16MB"

# Partition Table
CONFIG_PARTITION_TABLE_SINGLE_APP_LARGE=y

# PSRAM configuration for ESP32-S3
CONFIG_ESP32S3_SPIRAM_SUPPORT=y
CONFIG_SPIRAM_MODE_OCT=y
CONFIG_SPIRAM=y
CONFIG_SPIRAM_SPEED_80M=y
CONFIG_SPIRAM_USE_MALLOC=y

# Compiler options
CONFIG_COMPILER_OPTIMIZATION_PERF=y

# FreeRTOS
CONFIG_FREERTOS_HZ=1000

# ESP System
CONFIG_ESP_DEFAULT_CPU_FREQ_240=y
CONFIG_ESP_MAIN_TASK_STACK_SIZE=8192

# Log output
CONFIG_LOG_DEFAULT_LEVEL_INFO=y
CONFIG_LOG_MAXIMUM_LEVEL_VERBOSE=y

# LVGL Configuration
CONFIG_LV_MEM_CUSTOM=n
CONFIG_LV_MEMCPY_MEMSET_STD=y
CONFIG_LV_ATTRIBUTE_FAST_MEM_USE_IRAM=y
CONFIG_LV_FONT_MONTSERRAT_32=y

# WiFi Configuration
CONFIG_ESP_WIFI_SSID=""
CONFIG_ESP_WIFI_PASSWORD=""
CONFIG_ESP_MAXIMUM_RETRY=5

# LWIP (TCP/IP stack)
CONFIG_LWIP_MAX_SOCKETS=16

# HTTPS/TLS Configuration
CONFIG_ESP_TLS_INSECURE=n
CONFIG_ESP_TLS_SKIP_SERVER_CERT_VERIFY=n
CONFIG_MBEDTLS_CERTIFICATE_BUNDLE=y
CONFIG_MBEDTLS_CERTIFICATE_BUNDLE_DEFAULT_FULL=y

# HTTP Client
CONFIG_ESP_HTTP_CLIENT_ENABLE_HTTPS=y

# cJSON
CONFIG_CJSON_USE_LOCALES=n
```
